## conf/local.conf
```bitbake
# CONF_VERSION is increased each time build/conf/ changes incompatibly
CONF_VERSION = "1"

#INHERIT += "rm_work" 
INHERIT += "buildhistory"
BUILDHISTORY_COMMIT = "1"

# Which files do we want to parse:

# What kind of additional images do we want?
# default is sdimg.xz, but ext4, ext4.xz and uncompressed sdimg are possible
IMAGE_FSTYPES = ""

# Remove old image file (to save space) before new one is created.
RM_OLD_IMAGE="1"

# Make use of SMP:
#   PARALLEL_MAKE specifies how many concurrent compiler threads are spawned per bitbake process
#   BB_NUMBER_THREADS specifies how many concurrent bitbake tasks will be run
PARALLEL_MAKE     = "-j 9"
BB_NUMBER_THREADS = "9"

DISTRO = "angstrom-v2014.12"

# classic way to extend image
#CORE_IMAGE_EXTRA_INSTALL += "mono fsharp"
#preferred way to add packages 
#IMAGE_INSTALL_append = " mono fsharp"

# Set DEPLOY_DIR outside of TMPDIR

PACKAGE_CLASSES = "package_ipk"
SDKMACHINE = "i686"
SDK_NAME_PREFIX = "trik-sdk"
SDKPATH = "/opt/${SDK_NAME_PREFIX}"

EXTRA_IMAGE_FEATURES = "debug-tweaks"
USER_CLASSES += "buildstats"

DEPLOY_DIR = "${TMPDIR}/../../deploy/${TCLIBC}"
# Don't generate the mirror tarball for SCM repos, the snapshot is enough
BB_GENERATE_MIRROR_TARBALLS = "0"

# Disable build time patch resolution. This would lauch a devshell
# and wait for manual intervention. We disable it.
PATCHRESOLVE = "noop"

#
# Shared-state files from other locations
#
# Shared state files are prebuilt cache data objects which can 
# used to accelerate build time. This variable can be used to configure the system
# to search other mirror locations for these objects before it builds the data itself.
#
# This can be a filesystem directory, or a remote url such as http or ftp. These
# would contain the sstate-cache results from previous builds (possibly from other 
# machines). This variable works like fetcher MIRRORS/PREMIRRORS and points to the 
# cache locations to check for the shared objects.
#SSTATE_MIRRORS ?= "\
#file://.* http://someserver.tld/share/sstate/ \n \
#file://.* file:///some/local/dir/sstate/"

#SSTATE_MIRRORS ?= "\
#file://.* http://dominion.thruhere.net/angstrom/sstate-mirror/ \n "

# enable PR service on build machine itself
# its good for a case when this is the only builder
# generating the feeds
#
PRSERV_HOST = "localhost:0"

PREMIRRORS_prepend = "\
     git://.*/.* http://downloads.trikset.com/mirror/downloads/ \n \
     ftp://.*/.* http://downloads.trikset.com/mirror/downloads/ \n \
     http://.*/.* http://downloads.trikset.com/mirror/downloads/ \n \
     https://.*/.* http://downloads.trikset.com/mirror/downloads/ \n"

LICENSE_FLAGS_WHITELIST = "commercial_gst-fluendo-mp3 \
                          commercial_gst-openmax \
                          commercial_gst-plugins-ugly \
                          commercial_lame \
                          commercial_libmad \
                          commercial_libav \
                          commercial_x264 \
                          commercial_gst-ffmpeg \
                          commercial_mpeg2dec \
			  commercial_libpostproc \
"
```
